## Kconfig
```kconfig
#
# Copyright © 2017-2019 The Crust Firmware Authors.
# SPDX-License-Identifier: BSD-3-Clause OR GPL-2.0-only
#

mainmenu "Crust Firmware Configuration"

config PLATFORM
	string
	default "a64" if PLATFORM_A64
	default "a83t" if PLATFORM_A83T
	default "h3" if PLATFORM_H3
	default "h6" if PLATFORM_H6

choice
	prompt "Platform selection"

config PLATFORM_A64
	bool "A64/H5/R18"

config PLATFORM_A83T
	bool "A83T"

config PLATFORM_H3
	bool "H3"

config PLATFORM_H6
	bool "H6"

endchoice

config SOC
	string
	default "A64" if SOC_A64
	default "H5" if SOC_H5

choice
	prompt "SoC"

config SOC_A64
	bool "A64"

config SOC_H5
	bool "H5"

endchoice

source "drivers/Kconfig"

menu "Debugging options"

config ASSERT
	bool "Enable runtime assertion checking"
	default y
	help
		Enable assert() logic to validate assumptions and find
		bugs at runtime. If in doubt, say Y.

config ASSERT_VERBOSE
	bool "Report detailed information about failed assertions"
	depends on ASSERT
	help
		When an assertion fails, print detailed information
		about it to the console. This includes the expression
		that was checked, as well as the file and line number of
		the call to assert().

		Enabling this option makes it significantly easier to
		find the code that triggered an assertion failure. Note
		that this option significantly increases the size of the
		final firmware binary. If in doubt, say N.

config DEBUG_INFO
	bool "Compile the firmware with debug info"
	default y
	help
		When compiling the firmware, generate debug information
		for use with gdb. These are stripped out of the final
		firmware binary, so this option does not affect the
		loaded firmware size. If in doubt, say Y.

config DEBUG_LOG
	bool "Print additional debug-level log messages"
	default y
	help
		This enables the debug() logging macro to print verbose
		informational messages that may aid in debugging.

endmenu
```

## configs/pinephone_defconfig
```kconfig
CONFIG_IRQ_POLL_EINT=y
CONFIG_IRQ_POLL_EINT_LAST_BANK=0
CONFIG_MFD_AXP20X=y
CONFIG_SERIAL=y
CONFIG_DEBUG_INFO=y
CONFIG_DEBUG_PRINT_BATTERY=y
```
